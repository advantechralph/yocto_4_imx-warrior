## packages/yocto/imx-warrior/meta-advantech/conf/layer.conf
```bitbake
# We have a conf and classes directory, add to BBPATH
BBPATH .= ":${LAYERDIR}"

# We have recipes-* directories, add to BBFILES
BBFILES += "${LAYERDIR}/recipes-*/*/*.bb \
	${LAYERDIR}/recipes-*/*/*.bbappend"

BBFILE_COLLECTIONS += "tpc71wn21pa"
BBFILE_PATTERN_tpc71wn21pa = "^${LAYERDIR}/"
BBFILE_PRIORITY_tpc71wn21pa = "12"

LAYERSERIES_COMPAT_tpc71wn21pa = "warrior"
```

## packages/yocto/imx-warrior/meta-advantech/conf/machine/imx6qtpc71wn21pa.conf
```bitbake
#@TYPE: Machine
#@NAME: NXP i.MX6Q SABRE Smart Device
#@SOC: i.MX6Q
#@DESCRIPTION: Machine configuration for NXP i.MX6Q SABRE Smart Device
#@MAINTAINER: Otavio Salvador <otavio@ossystems.com.br>

MACHINEOVERRIDES =. "mx6:mx6q:"

require conf/machine/include/imx6sabresd-common.inc
require conf/machine/include/advantech-default-settings.inc

KERNEL_DEVICETREE = "imx6q-sabresd.dtb imx6q-tpc71w-n21pa.dtb"

MACHINE_FEATURES_append = ""

UBOOT_CONFIG ??= "${@bb.utils.contains('COMBINED_FEATURES', 'optee', 'sd-optee', 'sd', d)}"
UBOOT_CONFIG[sd] = "mx6qsabresd_config,sdcard"
UBOOT_CONFIG[sata] = "mx6qsabresd_sata_config"
UBOOT_CONFIG[mfgtool] = "mx6qsabresd_config"
UBOOT_CONFIG[sd-optee] = "mx6qsabresd_optee_config,sdcard"

OPTEE_BIN_EXT = "6qsdb"

# SDCARD_ROOTFS = "${DEPLOY_DIR_IMAGE}/${IMAGE_NAME}.rootfs.ext4"
SDCARD_ROOTFS = "${IMGDEPLOYDIR}/${IMAGE_NAME}${IMAGE_NAME_SUFFIX}.ext4"
# IMAGE_FSTYPES = "tar.bz2 ext4"
IMAGE_FSTYPES = "tar.gz ext4 sdcard"
# IMAGE_FSTYPES_DEBUGFS = "${IMAGE_FSTYPES}"

BOOT_SPACE = "16384"

UBOOT_CONFIG[1G] = "mx6qtpc71wn21pa_1G_config,sdcard"

# build all vpu firmware packages into the image
MACHINE_FIRMWARE_append_mx6 = " firmware-imx-vpu-imx6q firmware-imx-vpu-imx6d"
```
